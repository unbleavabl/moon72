## firmware/zmk-config/config/boards/shields/moon72/Kconfig.defconfig
```kconfig
if SHIELD_MOON72_LEFT

config ZMK_KEYBOARD_NAME
    default "Moon72"

config ZMK_SPLIT_ROLE_CENTRAL
    default y

endif

if SHIELD_MOON72_LEFT || SHIELD_MOON72_RIGHT

config ZMK_SPLIT
    default y

endif
```

## firmware/zmk-config/config/boards/shields/moon72/Kconfig.shield
```kconfig
config SHIELD_MOON72_LEFT
    def_bool $(shields_list_contains,moon72_left)

config SHIELD_MOON72_RIGHT
    def_bool $(shields_list_contains,moon72_right)
```
